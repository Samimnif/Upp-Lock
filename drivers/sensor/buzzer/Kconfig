## drivers/sensor/buzzer/Kconfig
```kconfig
config GPIO_BUZZER
    bool "GPIO buzzer driver"
    default y
    depends on GPIO
    help
      Enable a simple GPIO buzzer driver.
```

## drivers/sensor/ltr303/Kconfig
```kconfig
config LTR303
    bool "LTR303 ambient light sensor driver"
    default y
    depends on I2C
    depends on SENSOR
    help
      Enable the custom LTR303 ambient light sensor driver.
```

## drivers/sensor/mpu6050/Kconfig
```kconfig
config MPU6050_CUSTOM
    bool "MPU6050 custom sensor"
    default y
    depends on I2C
```

## drivers/sensor/rgb_led/Kconfig
```kconfig
config RGB_LED
    bool "Custom RGB LED driver"
    default y
    depends on GPIO && LED
    help
      Enable the custom RGB LED driver.
      Drives a common-cathode RGB LED connected to three GPIO pins.
```

## drivers/sensor/ss49e/Kconfig
```kconfig
config SS49E
    bool "SS49E Hall Effect Sensor Driver"
    default y
    depends on ADC
    depends on SENSOR
    help
      Enable driver for SS49E linear Hall effect sensor.
```
